/{
		huawei_fac_info {
		compatible = "huawei,hw_fac_info";
		fac,product_name = "DLI-TL10";
		fac,hardware_ver = "HL1DLIM-TL10";
		fac,software_ver = "DLI_TL10_VA";
		fac,simcard_adapt = "support";
		status = "ok";
	};
};
