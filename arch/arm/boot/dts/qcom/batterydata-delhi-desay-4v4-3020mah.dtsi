qcom,batterydata-delhi-desay-4v4-3020mah {
	/* #2503914_Wingtech_Delhi_Desay_3020mAh_averaged_MasterSlave_Jul25th2016*/
	qcom,max-voltage-uv = <4400000>;
	qcom,nom-batt-capacity-mah = <3020>;
	qcom,batt-id-kohm = <39>;
	qcom,battery-beta = <3435>;
	qcom,battery-type = "batterydata-delhi-desay-4v4-3020mah";
	qcom,chg-rslow-comp-c1 = <3143918>;
	qcom,chg-rslow-comp-c2 = <4374958>;
	qcom,chg-rs-to-rslow = <1263535>;
	qcom,chg-rslow-comp-thr = <0xA3>;
	qcom,checksum = <0x7CBF>;
	qcom,gui-version = "PMI8950GUI - 2.0.0.16";
	qcom,fg-profile-data = [
		 F2 83 78 7D 
		 91 81 14 7C 
		 55 83 7E 58 
		 22 80 16 87 
		 23 82 52 9A 
		 91 BD B8 CA 
		 5C 0E F5 83 
		 13 7D 24 81 
		 27 77 48 83 
		 79 72 A7 76 
		 0B 67 56 82 
		 3B 99 51 BC 
		 CD C8 5E 0D 
		 B4 0B 4D 5A 
		 14 70 B2 FD 
		 55 2D B0 44 
		 5F 30 00 00 
		 9F 47 4F 16 
		 93 41 00 00 
		 00 00 00 00 
		 00 00 00 00 
		 02 71 51 70 
		 91 68 57 83 
		 07 74 B2 61 
		 1D 63 3A 80 
		 F9 6D 8B 59 
		 F9 58 7A A2 
		 1D E5 63 59 
		 65 A0 71 0C 
		 28 00 FF 36 
		 F0 11 30 03 
		 00 00 00 0C 
	];
};
