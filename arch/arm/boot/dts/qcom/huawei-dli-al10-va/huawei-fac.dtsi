/{
		huawei_fac_info {
		compatible = "huawei,hw_fac_info";
		fac,product_name = "DLI-AL10";
		fac,hardware_ver = "HL1DLIM-AL10";
		fac,software_ver = "DLI_AL10_VA";
		fac,simcard_adapt = "support";
		status = "ok";
	};
};
