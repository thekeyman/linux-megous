/{
		huawei_fac_info {
		compatible = "huawei,hw_fac_info";
		fac,product_name = "DLI-L42";
		fac,hardware_ver = "HL1DLIM-L42";
		fac,software_ver = "DLI_L42_VA";
		fac,simcard_adapt = "support";
		status = "ok";
	};
};
