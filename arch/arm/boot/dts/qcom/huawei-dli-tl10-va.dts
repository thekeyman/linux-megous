/dts-v1/;
#include "huawei_msm8937_base.dtsi"
#include "huawei-dli-tl10-va/huawei.dtsi"
#include "lcdkit/default/default_auo_otm1901a_5p2_1080p_video_default.dtsi"
/ {
       model = "Huawei Technologies, Inc. Delhi-TL10";
       compatible = "qcom,msm8937-pmi8937-qrd-sku2",
                   "qcom,msm8937-qrd", "qcom,msm8937", "qcom,qrd";
        qcom,board-id= <9014 0>;
       /* huawei,modem_id = <0xF8F00080 0x0>;*/
};
