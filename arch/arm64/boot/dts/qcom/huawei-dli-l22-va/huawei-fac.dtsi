/{
		huawei_fac_info {
		compatible = "huawei,hw_fac_info";
		fac,product_name = "DLI-L22";
		fac,hardware_ver = "HL1DLIM-L22";
		fac,software_ver = "DLI_L22_VA";
		fac,simcard_adapt = "support";
		status = "ok";
	};
};
