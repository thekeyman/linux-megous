/{
		huawei_fac_info {
		compatible = "huawei,hw_fac_info";
		fac,product_name = "DLI-AL00";
		fac,hardware_ver = "HL1DLIM-AL00";
		fac,software_ver = "DLI_AL00_VA";
		fac,simcard_adapt = "support";
		status = "ok";
	};
};
