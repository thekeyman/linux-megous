qcom,batterydata-delhi-sucd-costlight-4v4-3020mah {
	/* #2503877_Wingtech_Delhi-sucd-Coslight_3020mAh_averaged_MasterSlave_Jul25th2016*/
	qcom,max-voltage-uv = <4400000>;
	qcom,nom-batt-capacity-mah = <3020>;
	qcom,batt-id-kohm = <68>;
	qcom,battery-beta = <3435>;
	qcom,battery-type = "batterydata-delhi-sucd-costlight-4v4-3020mah";
	qcom,chg-rslow-comp-c1 = <5265841>;
	qcom,chg-rslow-comp-c2 = <12152890>;
	qcom,chg-rs-to-rslow = <1285469>;
	qcom,chg-rslow-comp-thr = <0xC9>;
	qcom,checksum = <0xBC0C>;
	qcom,gui-version = "PMI8950GUI - 2.0.0.16";
	qcom,fg-profile-data = [
		 EB 83 36 7D
		 5B 81 C2 77
		 59 83 03 5F
		 03 82 FD 8C
		 11 82 C8 9A
		 11 BE 6B CB
		 5A 0E F4 83
		 02 7D 13 81
		 04 77 53 83
		 A4 6A 55 78
		 13 86 3E 82
		 0E 9A 59 BD
		 69 CA 58 0D
		 D4 0B 5A 5A
		 14 70 B2 FD
		 51 34 78 46
		 EB 40 00 00
		 1A 4C 86 32
		 C6 3A 00 00
		 00 00 00 00
		 00 00 00 00
		 47 71 C6 6B
		 7F 67 BD 89
		 9B 7C CB 71
		 6A 66 FF 7A
		 F4 75 5A 6A
		 19 66 F4 A1
		 27 3C 5B CD
		 5C A0 71 0C
		 28 00 FF 36
		 F0 11 30 03
		 00 00 00 0C
	];
};
